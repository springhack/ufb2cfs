## sdkconfig.defaults
```kconfig
CONFIG_ESP_CONSOLE_NONE=y
CONFIG_FREERTOS_UNICORE=y
CONFIG_ESP_DEFAULT_CPU_FREQ_MHZ_240=y
CONFIG_GPIO_CTRL_FUNC_IN_IRAM=y
CONFIG_ESP_SYSTEM_CHECK_INT_LEVEL_4=y
CONFIG_ESP_INT_WDT=n
CONFIG_ESP_TASK_WDT_EN=n
CONFIG_COMPILER_OPTIMIZATION_PERF=y
```
